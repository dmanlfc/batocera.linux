## package/batocera/boot/uboot-odroid-go-ultra/Config.in
```kconfig
config BR2_PACKAGE_UBOOT_ODROID_GO_ULTRA
    bool "uboot-odroid-go-ultra"
    help
        uboot build package for the Odroid-Go Ultra
```

## package/batocera/emulators/openbor/openbor_plus4/Config.in
```kconfig
config BR2_PACKAGE_OPENBOR_PLUS4
    bool "openbor_plus4"
    select BR2_PACKAGE_LIBVPX
    select BR2_PACKAGE_SDL2
    select BR2_PACKAGE_SDL2_GFX
    select BR2_PACKAGE_LIBPNG
    select BR2_PACKAGE_LIBOGG
    select BR2_PACKAGE_LIBVORBIS
    help
      OpenBOR PLUS is the ultimate 2D side scrolling engine for beat em' ups,
      shooters, and more! This version has all official features plus new features!
```

## package/batocera/emulators/zesarux/Config.in
```kconfig
config BR2_PACKAGE_ZESARUX
        bool "zesarux"
        select BR2_PACKAGE_AALIB             if BR2_PACKAGE_XORG7 # ?
        select BR2_PACKAGE_LIBSDL2
        select BR2_PACKAGE_NCURSES
        select BR2_PACKAGE_XLIB_LIBX11       if BR2_PACKAGE_XORG7
        select BR2_PACKAGE_XLIB_LIBXEXT      if BR2_PACKAGE_XORG7
        select BR2_PACKAGE_XLIB_LIBXXF86VM   if BR2_PACKAGE_XORG7
        help
          ZEsarUX is a ZX Machines Emulator for Unix.

          https://github.com/chernandezba/zesarux
```

## package/batocera/libraries/aalib/Config.in
```kconfig
config BR2_PACKAGE_AALIB
        bool "aalib"
        select BR2_PACKAGE_GPM
        select BR2_PACKAGE_XLIB_LIBX11
        select BR2_PACKAGE_XLIB_LIBXT
        help
          A portable ASCII art graphics library.

          http://aa-project.sourceforge.net/aalib/
```

## package/batocera/ports/perfect-dark/Config.in
```kconfig
config BR2_PACKAGE_PERFECT_DARK
    bool "perfect-dark"
    select BR2_PACKAGE_SDL2
    select BR2_PACKAGE_OPENAL
    help
      Work in progress port of n64decomp/perfect_dark to modern platforms.

      https://github.com/fgsfdsfgs/perfect_dark
```

## package/batocera/ports/prboom-plus/Config.in
```kconfig
config BR2_PACKAGE_PRBOOM_PLUS
    bool "prboom-plus"
    select BR2_PACKAGE_SDL2
    select BR2_PACKAGE_SDL2_NET
    select BR2_PACKAGE_SDL2_MIXER
    select BR2_PACKAGE_SDL2_IMAGE
    select BR2_PACKAGE_FLUIDSYNTH
    select BR2_PACKAGE_LIBGLU
    select BR2_PACKAGE_LIBMAD
    select BR2_PACKAGE_LIBVORBIS
    select BR2_PACKAGE_PCRE
    help
      PrBoom+ is a Doom source port developed from the original PrBoom project.

	    https://github.com/coelckers/prboom-plus
```

## package/batocera/ports/sorr/Config.in
```kconfig
config BR2_PACKAGE_SORR
	bool "sorr"
	help
	  Bennu Game Development 2 engine to support
	  the Streets Of Rage Remake.

	  https://github.com/SplinterGU/BennuGD2
```
